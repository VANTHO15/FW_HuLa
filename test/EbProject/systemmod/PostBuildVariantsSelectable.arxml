AUTOSAR XML (schema 4-2-1)
package /EB/PostBuildSelectable
  predefined variant VS0: post-build-variant-criterion-value-set=PostBuildCriterionValueSet_VS0
  predefined variant VS1: post-build-variant-criterion-value-set=PostBuildCriterionValueSet_VS1
  post build variant criterion value set PostBuildCriterionValueSet_VS0: post-build-variant-criterion-value{variant-criterion=my, value=0}
  post build variant criterion value set PostBuildCriterionValueSet_VS1: post-build-variant-criterion-value{variant-criterion=my, value=1}
package /EB/PostBuildSelectable/Criterions
  post build variant criterion my: compu {0=, 1=}
